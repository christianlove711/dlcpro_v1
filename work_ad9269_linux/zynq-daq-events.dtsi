/*
 * Apply on top of the XSA-generated nodes.  Both AXI DMA instances have only
 * S2MM enabled:
 *
 *   axi_dma_0   0x40400000, IRQ_F2P[0], HP0, Event frames
 *   scope_dma_1 0x40410000, IRQ_F2P[1], HP1, Scope frames
 *
 * Keep the generated clocks, xlnx,addrwidth and data-width properties.
 */
/ {
  zynq_daq: zynq-daq@43c10000 {
    compatible = "acme,zynq-daq-dualdma-2.0";
    reg = <0x43c10000 0x10000>;
    /* Xilinx AXI DMA #dma-cells: 0=MM2S, 1=S2MM. */
    dmas = <&axi_dma_0 1>, <&scope_dma_1 1>;
    dma-names = "event-rx", "scope-rx";

    acme,event-frame-bytes = <8320>;
    acme,event-ring-slots = <64>;
    acme,event-slot-stride = <12288>;
    acme,scope-frame-bytes = <32832>;
    acme,scope-ring-slots = <16>;
    acme,scope-slot-stride = <36864>;
  };
};
